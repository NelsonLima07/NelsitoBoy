/*
 * game_01_breakout.c
 *
 *  Created on: Apr 21, 2025
 *      Author: Nelson Lima
 */


#include "usr/lib_GameStruct.h"
#include "usr/lib_J3_ST7789VW.h"

#include <stdbool.h>


const TTile listaTiles[4] = {
		 { 0x01, 0x01, 0x01, 0x01, 0x01, 0x01, 0x01, 0x01,
		   0x01, 0x00, 0x00, 0x00, 0x00, 0x00, 0x00, 0x01,
		   0x01, 0x00, 0x00, 0x00, 0x00, 0x00, 0x00, 0x01,
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		   0x01, 0x01, 0x01, 0x01, 0x01, 0x01, 0x01, 0x01
		 },
		 { 0x0B, 0x0B, 0x07, 0x07, 0x07, 0x07, 0x0B, 0x0B, // Bola
		   0x0B, 0x07, 0x07, 0x07, 0x07, 0x07, 0x07, 0x0B,
		   0x07, 0x07, 0x07, 0x07, 0x07, 0x07, 0x07, 0x07,
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		   0x0B, 0x0B, 0x07, 0x07, 0x07, 0x07, 0x0B, 0x0B
		 },
		 {
		   0x01, 0x01, 0x01, 0x01, 0x01, 0x01, 0x01, 0x01,
		   0x01, 0x00, 0x00, 0x00, 0x00, 0x00, 0x00, 0x01,
		   0x01, 0x00, 0x00, 0x00, 0x00, 0x00, 0x00, 0x01,
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		   0x01, 0x01, 0x01, 0x01, 0x01, 0x01, 0x01, 0x01
		 },

		 { 0x01, 0x01, 0x01, 0x01, 0x01, 0x01, 0x01, 0x01,
		   0x01, 0x00, 0x00, 0x00, 0x00, 0x00, 0x00, 0x01,
		   0x01, 0x00, 0x00, 0x00, 0x00, 0x00, 0x00, 0x01,
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		   0x01, 0x01, 0x01, 0x01, 0x01, 0x01, 0x01, 0x01
		 }
};

 TPaletaCor paletaGame = {
		 COLOR_BLACK, COLOR_WHITE, COLOR_BLUE, COLOR_BEIGE, COLOR_BROWN, COLOR_CYAN, COLOR_DARK_BLUE, COLOR_RED,
		 COLOR_DARK_GRAY, COLOR_DARK_GREEN, COLOR_DARK_RED, COLOR_GOLD, COLOR_GRAY, COLOR_GREEN, COLOR_LIGHT_BLUE,
		 COLOR_LIGHT_GRAY
 };

 uint8_t mapTime[1200];

 typedef struct {
	 uint8_t posX;
	 uint8_t posY;
	 int8_t velocidade_X;
	 int8_t velocidade_Y;
	 uint8_t idxTile;
 } TSpriteMov;

 typedef struct {
	 uint8_t posX1;
	 uint8_t posY1;
	 uint8_t posX2;
	 uint8_t posY2;
 } TRectWind;




void main_game(void){
	bool gameLoopOn = true;
	TRectWind clrWind;
	uint8_t gameDelay = 20;

	TSpriteMov bola;

	bola.posX = 10;
	bola.posY = 10;
	bola.velocidade_X = 2;
	bola.velocidade_Y = 0;
	bola.idxTile = 1;

	ST7789VW_FillScreen2(paletaGame.corRGB565[0x0B]);
	//J3GameEngine_DesenhaTile(listaTiles[1], 50 ,50);
	while(gameLoopOn){
		//ST7789VW_FillScreen2(paletaGame.corRGB565[0x0B]);
		ST7789VW_FillWindow(clrWind.posX1, clrWind.posY1, clrWind.posX2, clrWind.posY2, paletaGame.corRGB565[0x0B]);
		J3GameEngine_DesenhaTile(listaTiles[bola.idxTile], bola.posX ,bola.posY);

		clrWind.posX1 = bola.posX;
		clrWind.posX2 = bola.posX + 7;
		clrWind.posY1 = bola.posY;
		clrWind.posY2 = bola.posY + 7;

		bola.posX =  bola.posX + bola.velocidade_X;
		if(bola.posX >= 320){
			bola.posX = 320 - 1;
			bola.velocidade_X = bola.velocidade_X * (-1);
		}

		bola.posY =  bola.posY + bola.velocidade_Y;
		if(bola.posY >= 240){
			bola.posY = 240 - 1;
			bola.velocidade_Y = bola.velocidade_Y * (-1);
		}


		HAL_Delay(gameDelay);
	}

}


